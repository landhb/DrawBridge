## tests/unittests/Kconfig
```kconfig
menu "Drawbridge support"

config DRAWBRIDGE
	bool "Actual Drawbridge Module"
	depends on POSIX_TIMERS 
	select CRYPTO
	select CRYPTO_RSA 

config DRAWBRIDGE_TESTS
	bool "Tests for Drawbridge SPA module"
	depends on DRAWBRIDGE && TEST

endmenu
```
